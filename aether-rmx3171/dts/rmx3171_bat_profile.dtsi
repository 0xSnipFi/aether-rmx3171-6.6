// SPDX-License-Identifier: GPL-2.0+
/*
 * AETHER RMX3171 — battery profile extracted from stock A11 boot dtb.
 *
 * MTK gm30 fuelgauge profile: SOC curve in 100 points at 5 temperatures
 * (t0..t4). Values are byte-equivalent with Realme stock factory image.
 *
 * Battery: 6000 mAh (per Realme product spec).
 * Capacity: 60000 mAh*0.1 (gm30 convention) — already in stock array.
 *
 * Generated by aether-rmx3171/build/extract_rmx3171_battery.sh
 */

&battery_manager {
		ACTIVE_TABLE = <0x06>;
		CAR_TUNE_VALUE = <0x64>;
		COM_FG_METER_RESISTANCE = <0x64>;
		COM_R_FG_VALUE = <0x00>;
		DIFFERENCE_FULLOCV_ITH = <0x140>;
		EMBEDDED_SEL = <0x00>;
		FG_METER_RESISTANCE = <0x64>;
		KEEP_100_PERCENT = <0x01>;
		MULTI_TEMP_GAUGE0 = <0x01>;
		PMIC_MIN_VOL = <0x82dc>;
		PMIC_SHUTDOWN_CURRENT = <0x14>;
		POWERON_SYSTEM_IBOOT = <0x1f4>;
		Q_MAX_SYS_VOLTAGE_BAT0 = <0xd16>;
		Q_MAX_SYS_VOLTAGE_BAT1 = <0xd16>;
		Q_MAX_SYS_VOLTAGE_BAT2 = <0xd16>;
		Q_MAX_SYS_VOLTAGE_BAT3 = <0xd16>;
		R_FG_VALUE = <0x05>;
		SHUTDOWN_1_TIME = <0x1e>;
		SHUTDOWN_GAUGE0_VOLTAGE = <0x84d0>;
		TEMPERATURE_T0 = <0x32>;
		TEMPERATURE_T1 = <0x19>;
		TEMPERATURE_T2 = <0x0a>;
		TEMPERATURE_T3 = <0x00>;
		TEMPERATURE_T4 = <0xfffffffa>;
		TEMPERATURE_T5 = <0xfffffff6>;
		battery0_profile_t0 = <0x00 0xaba4 0x384 0x203 0xab23 0x384 0x407 0xaaa9 0x384 0x60a 0xaa37 0x392 0x80e 0xa9c7 0x3a8 0xa11 0xa955 0x3af 0xc15 0xa8de 0x3a1 0xe18 0xa86e 0x3b6 0x101c 0xa7f6 0x3b6 0x121f 0xa77e 0x3a4 0x1423 0xa705 0x39d 0x1626 0xa68d 0x3a8 0x1829 0xa615 0x3b6 0x1a2d 0xa59c 0x3c9 0x1c30 0xa521 0x429 0x1e34 0xa4a8 0x3d3 0x2037 0xa430 0x3c6 0x223b 0xa3b8 0x3cf 0x243e 0xa33f 0x3c6 0x2642 0xa2c7 0x3b6 0x2845 0xa250 0x3b8 0x2a49 0xa1e0 0x3cd 0x2c4c 0xa168 0x3bb 0x2e4f 0xa0f6 0x3c6 0x3053 0xa087 0x3cf 0x3256 0xa017 0x3cf 0x345a 0x9faa 0x3d4 0x365d 0x9f43 0x3e8 0x3861 0x9edb 0x3e8 0x3a64 0x9e74 0x3e8 0x3c68 0x9e0d 0x3e8 0x3e6b 0x9dab 0x3f5 0x406f 0x9d49 0x401 0x4272 0x9ce7 0x407 0x4475 0x9c90 0x41a 0x4679 0x9c30 0x41a 0x487c 0x9bd9 0x42f 0x4a80 0x9b83 0x455 0x4c83 0x9b28 0x465 0x4e87 0x9aca 0x46f 0x508a 0x9a66 0x477 0x528e 0x99f1 0x459 0x5491 0x995f 0x403 0x5695 0x98d5 0x3c2 0x5898 0x986f 0x3b6 0x5a9b 0x981c 0x3b6 0x5c9f 0x97ce 0x3ac 0x5ea2 0x9787 0x3a4 0x60a6 0x974a 0x3b6 0x62a9 0x970e 0x3b6 0x64ad 0x96d2 0x3b6 0x66b0 0x9696 0x3a4 0x68b4 0x9660 0x39d 0x6ab7 0x962c 0x3a8 0x6cbb 0x95fb 0x3b6 0x6ebe 0x95cf 0x3b6 0x70c1 0x959c 0x3b6 0x72c5 0x9571 0x3b6 0x74c8 0x954d 0x3c8 0x76cc 0x9525 0x3cf 0x78cf 0x94fe 0x3da 0x7ad3 0x94dc 0x3e8 0x7cd6 0x94b8 0x3e4 0x7eda 0x948d 0x3d0 0x80dd 0x9474 0x3fb 0x82e1 0x9452 0x401 0x84e4 0x9430 0x401 0x86e7 0x940e 0x40c 0x88eb 0x93e5 0x412 0x8aee 0x93aa 0x3f3 0x8cf2 0x9354 0x3b6 0x8ef5 0x930f 0x3b6 0x90f9 0x92da 0x3b6 0x92fc 0x92ac 0x3c6 0x9500 0x927d 0x3c3 0x9703 0x924d 0x3bf 0x9907 0x9222 0x3cf 0x9b0a 0x91f7 0x3cf 0x9d0d 0x91d5 0x3cf 0x9f11 0x91ab 0x3e3 0xa114 0x9179 0x3e8 0xa318 0x913c 0x3db 0xa51b 0x90fb 0x3cf 0xa71f 0x90bf 0x3d5 0xa922 0x9080 0x3e4 0xab26 0x902a 0x3b9 0xad29 0x8fec 0x3a2 0xaf2d 0x8fd7 0x3ad 0xb130 0x8fcf 0x3d0 0xb333 0x8fc2 0x3f1 0xb537 0x8faf 0x413 0xb73a 0x8f91 0x451 0xb93e 0x8f55 0x47c 0xbb41 0x8e3e 0x418 0xbd45 0x8c86 0x423 0xbf48 0x8a30 0x44e 0xc14c 0x86fa 0x4a9 0xc34f 0x81b1 0x909 0xc553 0x785a 0x1991 0xc756 0x74ae 0x12d9>;
		battery0_profile_t0_col = <0x03>;
		battery0_profile_t0_num = <0x64>;
		battery0_profile_t1 = <0x00 0xabea 0x4ce 0x203 0xab72 0x4ca 0x407 0xab08 0x4db 0x60a 0xaa9b 0x4e2 0x80e 0xaa2b 0x4d7 0xa11 0xa9bc 0x4c9 0xc15 0xa94c 0x4cd 0xe18 0xa8dc 0x4e2 0x101c 0xa86d 0x4f8 0x121f 0xa7f6 0x4e9 0x1423 0xa77d 0x4e2 0x1626 0xa701 0x4d7 0x1829 0xa683 0x4c9 0x1a2d 0xa60a 0x4e0 0x1c30 0xa58f 0x553 0x1e34 0xa516 0x4ff 0x2037 0xa49e 0x4e2 0x223b 0xa426 0x4e2 0x243e 0xa3ad 0x4e2 0x2642 0xa335 0x4e2 0x2845 0xa2be 0x4e4 0x2a49 0xa24e 0x4f9 0x2c4c 0xa1d6 0x4fb 0x2e4f 0xa164 0x4fb 0x3053 0xa0f5 0x508 0x3256 0xa085 0x514 0x345a 0xa015 0x514 0x365d 0x9fa7 0x516 0x3861 0x9f3f 0x52b 0x3a64 0x9ed8 0x52d 0x3c68 0x9e71 0x53d 0x3e6b 0x9e0a 0x553 0x406f 0x9da7 0x568 0x4272 0x9d48 0x57e 0x4475 0x9cea 0x593 0x4679 0x9c8a 0x5a9 0x487c 0x9c2b 0x5bf 0x4a80 0x9bcd 0x5d4 0x4c83 0x9b6e 0x5ea 0x4e87 0x9b0b 0x5eb 0x508a 0x9aa2 0x5d5 0x528e 0x9a31 0x5ba 0x5491 0x99b9 0x579 0x5695 0x992f 0x524 0x5898 0x98bb 0x4f1 0x5a9b 0x9857 0x4d4 0x5c9f 0x9800 0x4bf 0x5ea2 0x97b3 0x4a9 0x60a6 0x9768 0x497 0x62a9 0x972c 0x497 0x64ad 0x96f0 0x497 0x66b0 0x96b4 0x497 0x68b4 0x967e 0x497 0x6ab7 0x964a 0x497 0x6cbb 0x9619 0x49e 0x6ebe 0x95ed 0x4ac 0x70c1 0x95ba 0x497 0x72c5 0x9597 0x4c2 0x74c8 0x956e 0x4c9 0x76cc 0x9543 0x4c9 0x78cf 0x951c 0x4c9 0x7ad3 0x94fa 0x4d1 0x7cd6 0x94d7 0x4e2 0x7eda 0x94b5 0x4e2 0x80dd 0x9493 0x4e2 0x82e1 0x9470 0x4e2 0x84e4 0x9454 0x4f1 0x86e7 0x9436 0x4fb 0x88eb 0x9413 0x4f3 0x8aee 0x93f3 0x4e7 0x8cf2 0x93d7 0x4fa 0x8ef5 0x93ac 0x4e4 0x90f9 0x9381 0x4cf 0x92fc 0x9356 0x4b9 0x9500 0x932c 0x4b0 0x9703 0x92fd 0x4a7 0x9907 0x92ce 0x49c 0x9b0a 0x92ab 0x4ae 0x9d0d 0x9280 0x499 0x9f11 0x9264 0x4be 0xa114 0x9237 0x4a9 0xa318 0x9204 0x4a4 0xa51b 0x91c9 0x4b0 0xa71f 0x9187 0x4b0 0xa922 0x914a 0x4b0 0xab26 0x910e 0x4b0 0xad29 0x90ba 0x4b0 0xaf2d 0x907f 0x4b0 0xb130 0x9060 0x4b0 0xb333 0x904e 0x4b9 0xb537 0x9040 0x4d5 0xb73a 0x9035 0x500 0xb93e 0x901b 0x52b 0xbb41 0x8fd9 0x56a 0xbd45 0x8ee6 0x556 0xbf48 0x8d38 0x561 0xc14c 0x8ad7 0x59f 0xc34f 0x8787 0x627 0xc553 0x8237 0xa55 0xc756 0x779c 0x19af>;
		battery0_profile_t1_col = <0x03>;
		battery0_profile_t1_num = <0x64>;
		battery0_profile_t2 = <0x00 0xac12 0x820 0x83e 0x203 0xab91 0x81c 0x839 0x407 0xab1f 0x81b 0x839 0x60a 0xaab5 0x838 0x849 0x80e 0xaa49 0x84d 0x844 0xa11 0xa9dd 0x84d 0x751 0xc15 0xa974 0x84d 0x741 0xe18 0xa904 0x84d 0x714 0x101c 0xa88c 0x837 0x760 0x121f 0xa814 0x834 0x742 0x1423 0xa79b 0x834 0x704 0x1626 0xa723 0x834 0x69f 0x1829 0xa6ab 0x82c 0x66d 0x1a2d 0xa632 0x844 0x676 0x1c30 0xa5b7 0x918 0x643 0x1e34 0xa53e 0x86e 0x646 0x2037 0xa4c6 0x834 0x6ac 0x223b 0xa449 0x834 0x62a 0x243e 0xa3cf 0x834 0x637 0x2642 0xa35d 0x834 0x62b 0x2845 0xa2e5 0x834 0x62c 0x2a49 0xa26d 0x834 0x612 0x2c4c 0xa1f4 0x834 0x630 0x2e4f 0xa182 0x844 0x68e 0x3053 0xa113 0x85a 0x62d 0x3256 0xa0a3 0x866 0x67f 0x345a 0xa033 0x86b 0x67c 0x365d 0x9fc4 0x87f 0x645 0x3861 0x9f54 0x87f 0x694 0x3a64 0x9ef4 0x893 0x665 0x3c68 0x9e8f 0x8b9 0x6bb 0x3e6b 0x9e28 0x8ca 0x6ca 0x406f 0x9dbd 0x8dd 0x6d1 0x4272 0x9d4e 0x902 0x6ba 0x4475 0x9ce7 0x915 0x670 0x4679 0x9c80 0x915 0x705 0x487c 0x9c21 0x915 0x6c0 0x4a80 0x9bc9 0x915 0x6ec 0x4c83 0x9b69 0x915 0x6ef 0x4e87 0x9afd 0x901 0x714 0x508a 0x9a8b 0x8d6 0x6df 0x528e 0x9a12 0x8a5 0x7c0 0x5491 0x9991 0x84f 0x751 0x5695 0x9918 0x80e 0x7c0 0x5898 0x98a7 0x7ce 0x806 0x5a9b 0x9843 0x7a9 0x7e5 0x5c9f 0x97ec 0x789 0x8ad 0x5ea2 0x979f 0x76c 0x8ad 0x60a6 0x9754 0x76f 0x86b 0x62a9 0x9718 0x785 0x8df 0x64ad 0x96d4 0x770 0x92f 0x66b0 0x969d 0x77e 0x84d 0x68b4 0x9664 0x777 0x8a5 0x6ab7 0x962c 0x777 0x8ad 0x6cbb 0x95f9 0x785 0x8ed 0x6ebe 0x95c7 0x789 0x8b6 0x70c1 0x959c 0x79e 0x930 0x72c5 0x9571 0x79e 0x8f2 0x74c8 0x9546 0x7b0 0x856 0x76cc 0x951b 0x7b7 0x860 0x78cf 0x94f0 0x7b7 0x8df 0x7ad3 0x94c8 0x7bf 0x857 0x7cd6 0x94a5 0x7d4 0x97e 0x7eda 0x9483 0x7ea 0x97f 0x80dd 0x946a 0x7ff 0x9a7 0x82e1 0x9448 0x7ef 0x95e 0x84e4 0x9426 0x7f8 0x946 0x86e7 0x9408 0x80e 0x997 0x88eb 0x93ee 0x81b 0x957 0x8aee 0x93d4 0x81b 0x9cf 0x8cf2 0x93ba 0x81c 0x940 0x8ef5 0x93a1 0x832 0x9c0 0x90f9 0x9387 0x821 0x951 0x92fc 0x936d 0x81b 0x9d6 0x9500 0x934e 0x81b 0x942 0x9703 0x932c 0x824 0x942 0x9907 0x9308 0x839 0x9e2 0x9b0a 0x92dd 0x84d 0x9d1 0x9d0d 0x92b2 0x84d 0x970 0x9f11 0x928f 0x888 0x8f5 0xa114 0x9266 0x8b8 0x90c 0xa318 0x9231 0x8e3 0x906 0xa51b 0x91f1 0x917 0x8d6 0xa71f 0x91ac 0x952 0x8cf 0xa922 0x9168 0x981 0x8a4 0xab26 0x912c 0x9d7 0x881 0xad29 0x90d0 0xa19 0x87c 0xaf2d 0x9085 0xa8b 0x81a 0xb130 0x9055 0xb0c 0x838 0xb333 0x9037 0xb9f 0x859 0xb537 0x901b 0xc51 0x872 0xb73a 0x8ff8 0xd27 0x8bd 0xb93e 0x8fd6 0xeaa 0x866 0xbb41 0x8f93 0x107e 0x758 0xbd45 0x8edc 0x12cc 0x7a7 0xbf48 0x8d56 0x15a5 0x70f 0xc14c 0x8b03 0x1a62 0x5af 0xc34f 0x87c7 0x24ce 0x48e 0xc553 0x8326 0x3490 0x436 0xc756 0x7c92 0x262f 0x436>;
		battery0_profile_t2_col = <0x04>;
		battery0_profile_t2_num = <0x64>;
		battery0_profile_t3 = <0x00 0xac26 0xea6 0x4d8 0x203 0xab94 0xea6 0x4d3 0x407 0xab10 0xeee 0x92e 0x60a 0xaa9b 0xf18 0xaae 0x80e 0xaa2b 0xf23 0xa70 0xa11 0xa9b9 0xf1c 0xa43 0xc15 0xa942 0xf0e 0xa00 0xe18 0xa8d2 0xf22 0x9ce 0x101c 0xa85a 0xef7 0x9a3 0x121f 0xa7e2 0xedf 0x9c6 0x1423 0xa769 0xeba 0x98d 0x1626 0xa6f1 0xea6 0x941 0x1829 0xa679 0xea6 0x93a 0x1a2d 0xa600 0xee6 0x914 0x1c30 0xa585 0x102d 0x90c 0x1e34 0xa50c 0xf08 0x8d3 0x2037 0xa48e 0xe77 0x8bb 0x223b 0xa417 0xe67 0x8c5 0x243e 0xa3a3 0xe74 0x8b2 0x2642 0xa32b 0xe6a 0x8a2 0x2845 0xa2b4 0xe45 0x8af 0x2a49 0xa244 0xe70 0x8a9 0x2c4c 0xa1cc 0xe60 0x89c 0x2e4f 0xa15a 0xe5b 0x89b 0x3053 0xa0eb 0xe68 0x8a0 0x3256 0xa07b 0xe6b 0x898 0x345a 0xa00b 0xe60 0x89a 0x365d 0x9f9d 0xe78 0x8b7 0x3861 0x9f3f 0xea3 0x8ca 0x3a64 0x9ed0 0xeba 0x8c8 0x3c68 0x9e61 0xeaf 0x8ce 0x3e6b 0x9df1 0xeb3 0x8f7 0x406f 0x9d7e 0xebf 0x90a 0x4272 0x9d08 0xebf 0x939 0x4475 0x9c98 0xeb6 0x962 0x4679 0x9c26 0xe5e 0x985 0x487c 0x9bbf 0xe5b 0x9ab 0x4a80 0x9b5f 0xe39 0x9c6 0x4c83 0x9af5 0xe37 0x9ef 0x4e87 0x9a85 0xe0f 0xa08 0x508a 0x9a13 0xdc5 0xa30 0x528e 0x999b 0xdb6 0xa85 0x5491 0x9923 0xd4a 0xab9 0x5695 0x98bb 0xd33 0xb1d 0x5898 0x985b 0xd1e 0xb61 0x5a9b 0x9802 0xcfa 0xb97 0x5c9f 0x97b0 0xcee 0xbac 0x5ea2 0x9763 0xcfd 0xc03 0x60a6 0x9717 0xd00 0xbf9 0x62a9 0x96d2 0xd16 0xc1a 0x64ad 0x9696 0xd01 0xc39 0x66b0 0x965a 0xd21 0xc58 0x68b4 0x9624 0xd2f 0xc59 0x6ab7 0x95f0 0xd45 0xc84 0x6cbb 0x95ba 0xd5a 0xc8a 0x6ebe 0x9581 0xd50 0xc7e 0x70c1 0x9556 0xd7a 0xca9 0x72c5 0x952b 0xda5 0xcc9 0x74c8 0x9500 0xdac 0xcd0 0x76cc 0x94d5 0xdac 0xce4 0x78cf 0x94ae 0xdb7 0xcfb 0x7ad3 0x948c 0xde3 0xd0e 0x7cd6 0x9469 0xe29 0xd48 0x7eda 0x9447 0xe2a 0xd2a 0x80dd 0x9425 0xe55 0xd6e 0x82e1 0x940a 0xe6e 0xd61 0x84e4 0x93f6 0xe74 0xd67 0x86e7 0x93e5 0xe96 0xd91 0x88eb 0x93d4 0xed7 0xd82 0x8aee 0x93c2 0xf13 0xd98 0x8cf2 0x93b1 0xf41 0xd76 0x8ef5 0x93a0 0xf97 0xd8a 0x90f9 0x9387 0x1000 0xd67 0x92fc 0x936d 0x104c 0xd5d 0x9500 0x9353 0x10ca 0xd67 0x9703 0x9333 0x115c 0xd38 0x9907 0x930a 0x11d1 0xd4b 0x9b0a 0x92e6 0x1266 0xcd6 0x9d0d 0x92b2 0x12e7 0xcc5 0x9f11 0x9287 0x13dd 0xc80 0xa114 0x924f 0x14cf 0xc4a 0xa318 0x920e 0x15a2 0xc35 0xa51b 0x91c9 0x1691 0xc3b 0xa71f 0x9184 0x17c8 0xc05 0xa922 0x913f 0x1918 0xbe0 0xab26 0x90f1 0x1a1a 0xb95 0xad29 0x909c 0x1bbb 0xb5c 0xaf2d 0x904d 0x1d37 0xb4e 0xb130 0x900f 0x1f4d 0xb5c 0xb333 0x8fe3 0x21d1 0xb88 0xb537 0x8fc1 0x24bf 0xbda 0xb73a 0x8f9d 0x28ee 0xbf2 0xb93e 0x8f72 0x2e62 0xb60 0xbb41 0x8f1f 0x352f 0xac5 0xbd45 0x8e72 0x3ca7 0xa09 0xbf48 0x8d10 0x4758 0x8e2 0xc14c 0x8b02 0x4a52 0x7f3 0xc34f 0x884a 0x4443 0x768 0xc553 0x884a 0x4443 0x768 0xc756 0x884a 0x4443 0x768>;
		battery0_profile_t3_col = <0x04>;
		battery0_profile_t3_num = <0x64>;
		battery0_profile_t4 = <0x00 0xac44 0x1e64 0x203 0xab90 0x1e60 0x407 0xaaf1 0x1ecb 0x60a 0xaa62 0x1f20 0x80e 0xa9d8 0x1f35 0xa11 0xa952 0x1f2e 0xc15 0xa8cf 0x1f2d 0xe18 0xa846 0x1ec3 0x101c 0xa7c5 0x1ead 0x121f 0xa744 0x1e61 0x1423 0xa6c3 0x1e46 0x1626 0xa643 0x1e24 0x1829 0xa5c5 0x1df3 0x1a2d 0xa54a 0x1e5a 0x1c30 0xa4c8 0x20c2 0x1e34 0xa447 0x1e74 0x2037 0xa3d2 0x1d91 0x223b 0xa35e 0x1d7e 0x243e 0xa2e5 0x1d75 0x2642 0xa26d 0x1d5b 0x2845 0xa1f6 0x1d33 0x2a49 0xa186 0x1d33 0x2c4c 0xa10e 0x1d47 0x2e4f 0xa09c 0x1d2c 0x3053 0xa032 0x1cf4 0x3256 0x9fcb 0x1cf3 0x345a 0x9f5f 0x1d33 0x365d 0x9ee7 0x1d31 0x3861 0x9e6f 0x1d1c 0x3a64 0x9dee 0x1d06 0x3c68 0x9d74 0x1ce0 0x3e6b 0x9cf7 0x1c41 0x406f 0x9c7a 0x1bd8 0x4272 0x9c01 0x1c0d 0x4475 0x9b8c 0x1c1b 0x4679 0x9b2c 0x1bf0 0x487c 0x9acd 0x1c17 0x4a80 0x9a61 0x1bfe 0x4c83 0x99f7 0x1bd3 0x4e87 0x998f 0x1bbc 0x508a 0x9928 0x1b9b 0x528e 0x98c3 0x1b45 0x5491 0x9864 0x1b70 0x5695 0x980e 0x1b1d 0x5898 0x97b8 0x1b30 0x5a9b 0x9768 0x1b23 0x5c9f 0x971f 0x1b37 0x5ea2 0x96da 0x1b78 0x60a6 0x9695 0x1b8a 0x62a9 0x9650 0x1b8a 0x64ad 0x9614 0x1bdf 0x66b0 0x95df 0x1bee 0x68b4 0x95ac 0x1c36 0x6ab7 0x9578 0x1c6b 0x6cbb 0x9545 0x1c8f 0x6ebe 0x9513 0x1cec 0x70c1 0x94e8 0x1d02 0x72c5 0x94c5 0x1d58 0x74c8 0x94a3 0x1d89 0x76cc 0x9486 0x1dd2 0x78cf 0x946d 0x1e28 0x7ad3 0x9456 0x1e8d 0x7cd6 0x9443 0x1f01 0x7eda 0x942a 0x1f45 0x80dd 0x9418 0x1ff0 0x82e1 0x9407 0x208a 0x84e4 0x93f6 0x212f 0x86e7 0x93e0 0x21c4 0x88eb 0x93ca 0x226d 0x8aee 0x93b7 0x2363 0x8cf2 0x939c 0x247e 0x8ef5 0x9383 0x2595 0x90f9 0x9361 0x264c 0x92fc 0x933f 0x2776 0x9500 0x931c 0x290b 0x9703 0x92fa 0x2abd 0x9907 0x92d6 0x2c4a 0x9b0a 0x92ab 0x2dc3 0x9d0d 0x9280 0x2fc6 0x9f11 0x924d 0x317b 0xa114 0x9219 0x3329 0xa318 0x91e1 0x3498 0xa51b 0x91a1 0x35e3 0xa71f 0x915f 0x3746 0xa922 0x9122 0x38b4 0xab26 0x90dd 0x3960 0xad29 0x9090 0x3aab 0xaf2d 0x9049 0x3b80 0xb130 0x900f 0x3ce0 0xb333 0x8fe3 0x3e93 0xb537 0x8fc3 0x4068 0xb73a 0x8fa8 0x437e 0xb93e 0x8f86 0x49df 0xbb41 0x8f55 0x5449 0xbd45 0x8ed9 0x53c8 0xbf48 0x8d90 0x50e2 0xc14c 0x8d90 0x510e 0xc34f 0x8d90 0x510e 0xc553 0x8d90 0x510e 0xc756 0x8d90 0x510e>;
		battery0_profile_t4_col = <0x03>;
		battery0_profile_t4_num = <0x64>;
		battery1_profile_t0 = <0x00 0xab36 0x3a2 0x1fb 0xaaa6 0x39e 0x3f5 0xaa25 0x39d 0x5f0 0xa9ab 0x3aa 0x7ea 0xa935 0x3b6 0x9e5 0xa8bf 0x3b6 0xbdf 0xa848 0x3b6 0xdda 0xa7ca 0x3b6 0xfd5 0xa752 0x3b6 0x11cf 0xa6d6 0x3a7 0x13ca 0xa65c 0x3a8 0x15c4 0xa5e3 0x3af 0x17bf 0xa566 0x3a0 0x19b9 0xa4ef 0x3b5 0x1bb4 0xa478 0x3fe 0x1dae 0xa402 0x3e5 0x1fa9 0xa38b 0x3b6 0x21a4 0xa313 0x3b1 0x239e 0xa296 0x39f 0x2599 0xa228 0x3b4 0x2793 0xa1b3 0x3b6 0x298e 0xa13c 0x3a7 0x2b88 0xa0cb 0x3a8 0x2d83 0xa05d 0x3b6 0x2f7e 0x9fef 0x3b6 0x3178 0x9f81 0x3b6 0x3373 0x9f14 0x3b6 0x356d 0x9ead 0x3c7 0x3768 0x9e48 0x3cf 0x3962 0x9de4 0x3cf 0x3b5d 0x9d7f 0x3cf 0x3d58 0x9d1a 0x3d0 0x3f52 0x9cc5 0x3e5 0x414d 0x9c63 0x3e8 0x4347 0x9c08 0x3f6 0x4542 0x9bb0 0x401 0x473c 0x9b58 0x40d 0x4937 0x9b0b 0x435 0x4b31 0x9ab7 0x44a 0x4d2c 0x9a5b 0x45f 0x4f27 0x99f7 0x465 0x5121 0x9980 0x442 0x531c 0x98f5 0x403 0x5516 0x986c 0x3c7 0x5711 0x97fe 0x39d 0x590b 0x97aa 0x39d 0x5b06 0x9763 0x39d 0x5d01 0x9720 0x39d 0x5efb 0x96e0 0x39d 0x60f6 0x96a5 0x398 0x62f0 0x966a 0x384 0x64eb 0x962e 0x384 0x66e5 0x95fb 0x384 0x68e0 0x95c8 0x384 0x6adb 0x9596 0x384 0x6cd5 0x9566 0x38b 0x6ed0 0x953c 0x39a 0x70ca 0x9512 0x385 0x72c5 0x94f0 0x398 0x74bf 0x94c8 0x39d 0x76ba 0x94a2 0x3a9 0x78b5 0x9481 0x3b6 0x7aaf 0x945f 0x3b6 0x7caa 0x943d 0x3b6 0x7ea4 0x941b 0x3b6 0x809f 0x9401 0x3c8 0x8299 0x93e2 0x3dd 0x8494 0x93c0 0x3e8 0x868e 0x9399 0x3e2 0x8889 0x9363 0x3cb 0x8a84 0x930f 0x3a0 0x8c7e 0x92ca 0x39d 0x8e79 0x9299 0x3ad 0x9073 0x926f 0x3b6 0x926e 0x9241 0x3b6 0x9468 0x9210 0x3b6 0x9663 0x91e6 0x3b6 0x985e 0x91bc 0x3a1 0x9a58 0x9199 0x3ae 0x9c53 0x9171 0x3b6 0x9e4d 0x9140 0x3b6 0xa048 0x9105 0x3b6 0xa242 0x90ca 0x3b6 0xa43d 0x908f 0x3b6 0xa638 0x904d 0x3b6 0xa832 0x8ffe 0x399 0xaa2d 0x8fc3 0x38f 0xac27 0x8fa9 0x3a4 0xae22 0x8fa1 0x3bc 0xb01c 0x8f98 0x3e6 0xb217 0x8f80 0x410 0xb411 0x8f60 0x45b 0xb60c 0x8ee1 0x44d 0xb807 0x8dbe 0x412 0xba01 0x8be3 0x413 0xbbfc 0x897b 0x468 0xbdf6 0x85e3 0x4e7 0xbff1 0x7f35 0x863 0xc1eb 0x74a4 0x1469 0xc3e6 0x74a4 0x1469>;
		battery1_profile_t0_col = <0x03>;
		battery1_profile_t0_num = <0x64>;
		battery1_profile_t1 = <0x00 0xab7c 0x65e 0x1fb 0xaaf5 0x65a 0x3f5 0xaa7c 0x659 0x5f0 0xaa05 0x659 0x7ea 0xa98f 0x659 0x9e5 0xa919 0x653 0xbdf 0xa8a3 0x640 0xdda 0xa82d 0x640 0xfd5 0xa7b6 0x640 0x11cf 0xa73a 0x622 0x13ca 0xa6c0 0x60e 0x15c4 0xa647 0x607 0x17bf 0xa5ca 0x5f5 0x19b9 0xa553 0x5f5 0x1bb4 0xa4dc 0x674 0x1dae 0xa460 0x63a 0x1fa9 0xa3e9 0x5dc 0x21a4 0xa379 0x5dc 0x239e 0xa303 0x5dc 0x2599 0xa28d 0x5dc 0x2793 0xa217 0x5dc 0x298e 0xa1a6 0x5dc 0x2b88 0xa134 0x5dc 0x2d83 0xa0c1 0x5dc 0x2f7e 0xa053 0x5dc 0x3178 0x9fe5 0x5dc 0x3373 0x9f78 0x5dc 0x356d 0x9f11 0x5ed 0x3768 0x9eac 0x5f5 0x3962 0x9e48 0x5fd 0x3b5d 0x9de3 0x612 0x3d58 0x9d7d 0x627 0x3f52 0x9d18 0x627 0x414d 0x9cb3 0x627 0x4347 0x9c53 0x635 0x4542 0x9bfa 0x64a 0x473c 0x9ba6 0x65f 0x4937 0x9b50 0x672 0x4b31 0x9af3 0x672 0x4d2c 0x9a97 0x685 0x4f27 0x9a2d 0x67b 0x5121 0x99b6 0x64f 0x531c 0x9934 0x600 0x5516 0x98b0 0x59e 0x5711 0x983a 0x55f 0x590b 0x97dd 0x535 0x5b06 0x978e 0x52d 0x5d01 0x9748 0x52d 0x5efb 0x9704 0x524 0x60f6 0x96c3 0x514 0x62f0 0x9688 0x514 0x64eb 0x9656 0x514 0x66e5 0x9623 0x527 0x68e0 0x95f0 0x51e 0x6adb 0x95be 0x514 0x6cd5 0x958e 0x51b 0x6ed0 0x9564 0x52d 0x70ca 0x953a 0x52d 0x72c5 0x9510 0x52d 0x74bf 0x94ec 0x53d 0x76ba 0x94ca 0x546 0x78b5 0x94a9 0x54e 0x7aaf 0x9487 0x55f 0x7caa 0x9465 0x55f 0x7ea4 0x9443 0x55f 0x809f 0x9429 0x571 0x8299 0x940a 0x578 0x8494 0x93ec 0x578 0x868e 0x93d0 0x578 0x8889 0x93ae 0x576 0x8a84 0x9383 0x561 0x8c7e 0x9361 0x55f 0x8e79 0x9339 0x54f 0x9073 0x930f 0x53a 0x926e 0x92e5 0x52d 0x9468 0x92ba 0x52d 0x9663 0x9290 0x52d 0x985e 0x9266 0x52d 0x9a58 0x9243 0x52d 0x9c53 0x9221 0x53a 0x9e4d 0x91f7 0x54f 0xa048 0x91c3 0x55f 0xa242 0x9188 0x561 0xa43d 0x914d 0x575 0xa638 0x9112 0x58a 0xa832 0x90cc 0x591 0xaa2d 0x9080 0x59c 0xac27 0x9044 0x5b1 0xae22 0x902c 0x5c9 0xb01c 0x901b 0x5f3 0xb217 0x900a 0x631 0xb411 0x8ff3 0x681 0xb60c 0x8fc1 0x6ee 0xb807 0x8f30 0x742 0xba01 0x8df5 0x765 0xbbfc 0x8bed 0x7be 0xbdf6 0x891f 0x8bb 0xbff1 0x84ca 0xa7c 0xc1eb 0x7cab 0x1cb3 0xc3e6 0x7814 0x1c07>;
		battery1_profile_t1_col = <0x03>;
		battery1_profile_t1_num = <0x64>;
		battery1_profile_t2 = <0x00 0xabcc 0xec4 0x728 0x1fb 0xab2c 0xec0 0x728 0x3f5 0xaaa0 0xebf 0x71e 0x5f0 0xaa1e 0xeb2 0x738 0x7ea 0xa99f 0xe8a 0x710 0x9e5 0xa923 0xe50 0x704 0xbdf 0xa8ac 0xe24 0x743 0xdda 0xa82e 0xde5 0x743 0xfd5 0xa7b6 0xdcb 0x69c 0x11cf 0xa73a 0xd98 0x6fd 0x13ca 0xa6c0 0xd64 0x6eb 0x15c4 0xa647 0xd3a 0x66d 0x17bf 0xa5ca 0xd0f 0x68a 0x19b9 0xa553 0xce5 0x68a 0x1bb4 0xa4dc 0xdf3 0x69d 0x1dae 0xa466 0xd6c 0x636 0x1fa9 0xa3ef 0xc86 0x614 0x21a4 0xa37b 0xc62 0x680 0x239e 0xa30d 0xc4c 0x676 0x2599 0xa297 0xc37 0x684 0x2793 0xa221 0xc0f 0x6e5 0x298e 0xa1b0 0xc03 0x663 0x2b88 0xa13e 0xbed 0x65a 0x2d83 0xa0cb 0xbca 0x656 0x2f7e 0xa05e 0xbbb 0x63b 0x3178 0x9ff9 0xbd0 0x631 0x3373 0x9f8c 0xbbd 0x629 0x356d 0x9f25 0xbc9 0x62f 0x3768 0x9ec0 0xbdd 0x625 0x3962 0x9e59 0xbea 0x62e 0x3b5d 0x9deb 0xbe6 0x610 0x3d58 0x9d7d 0xbd1 0x62f 0x3f52 0x9d18 0xbd1 0x61d 0x414d 0x9cac 0xbad 0x636 0x4347 0x9c49 0xb9f 0x653 0x4542 0x9be8 0xb95 0x643 0x473c 0x9b85 0xb80 0x645 0x4937 0x9b28 0xb6b 0x635 0x4b31 0x9acb 0xb56 0x64b 0x4d2c 0x9a67 0xb41 0x634 0x4f27 0x99fb 0xb1c 0x65f 0x5121 0x9989 0xada 0x676 0x531c 0x9916 0xa8e 0x68e 0x5516 0x98a8 0xa4e 0x69e 0x5711 0x983a 0xa0f 0x6be 0x590b 0x97e6 0x9fa 0x6d7 0x5b06 0x9791 0x9e5 0x6cf 0x5d01 0x9742 0x9d0 0x6f6 0x5efb 0x96fa 0x9bb 0x710 0x60f6 0x96b9 0x9ab 0x6ec 0x62f0 0x967e 0x9ab 0x6fc 0x64eb 0x9642 0x9ab 0x71b 0x66e5 0x960f 0x9be 0x723 0x68e0 0x95dc 0x9d3 0x71e 0x6adb 0x95aa 0x9dd 0x71e 0x6cd5 0x957a 0x9e4 0x723 0x6ed0 0x9550 0x9f6 0x71e 0x70ca 0x9526 0x9f6 0x72c 0x72c5 0x94fc 0xa0a 0x72f 0x74bf 0x94d2 0xa0f 0x72d 0x76ba 0x94ac 0xa1b 0x739 0x78b5 0x948b 0xa30 0x726 0x7aaf 0x9469 0xa41 0x73a 0x7caa 0x9447 0xa42 0x73e 0x7ea4 0x9425 0xa57 0x73b 0x809f 0x940b 0xa6c 0x725 0x8299 0x93f1 0xa81 0x73e 0x8494 0x93d8 0xa8c 0x744 0x868e 0x93bf 0xa92 0x748 0x8889 0x93a6 0xaa7 0x745 0x8a84 0x9395 0xabc 0x73b 0x8c7e 0x937d 0xad1 0x733 0x8e79 0x9363 0xae7 0x749 0x9073 0x934a 0xb13 0x756 0x926e 0x932e 0xb43 0x73e 0x9468 0x930c 0xb5c 0x744 0x9663 0x92ea 0xb86 0x72f 0x985e 0x92c0 0xb86 0x73c 0x9a58 0x929d 0xbba 0x732 0x9c53 0x9275 0xc21 0x70c 0x9e4d 0x9247 0xc83 0x718 0xa048 0x9213 0xcc8 0x707 0xa242 0x91d8 0xd1e 0x6e4 0xa43d 0x919d 0xd86 0x6e8 0xa638 0x915b 0xe01 0x6dc 0xa832 0x9112 0xe80 0x6d3 0xaa2d 0x90c6 0xeff 0x6bc 0xac27 0x907f 0xf91 0x698 0xae22 0x9046 0x1055 0x6a6 0xb01c 0x901c 0x113d 0x69a 0xb217 0x8ffa 0x128a 0x69d 0xb411 0x8fd2 0x141c 0x682 0xb60c 0x8f94 0x160c 0x64f 0xb807 0x8f23 0x1849 0x604 0xba01 0x8e5a 0x1ac4 0x5d4 0xbbfc 0x8d13 0x1d9b 0x637 0xbdf6 0x8aee 0x21d0 0x670 0xbff1 0x87c9 0x28cc 0x6bb 0xc1eb 0x832a 0x3219 0x6d1 0xc3e6 0x79c2 0x1fbd 0x65a>;
		battery1_profile_t2_col = <0x04>;
		battery1_profile_t2_num = <0x64>;
		battery1_profile_t3 = <0x00 0xabcc 0x1b76 0x728 0x1fb 0xab0a 0x1b72 0x16d6 0x3f5 0xaa6a 0x1b71 0x16d6 0x5f0 0xa9d2 0x1b56 0x16e9 0x7ea 0xa942 0x1b2c 0x16fd 0x9e5 0xa8b8 0x1afc 0x1723 0xbdf 0xa82a 0x1abf 0x1723 0xdda 0xa7ac 0x1a95 0x174a 0xfd5 0xa725 0x1a57 0x1770 0x11cf 0xa6a4 0x1a18 0x15cf 0x13ca 0xa621 0x19ce 0x145f 0x15c4 0xa59d 0x1980 0x132b 0x17bf 0xa51e 0x1941 0x1226 0x19b9 0xa4a0 0x1902 0x1154 0x1bb4 0xa421 0x1ab2 0x1074 0x1dae 0xa3a8 0x19ca 0xfaa 0x1fa9 0xa331 0x1857 0xf4e 0x21a4 0xa2bb 0x182d 0xeea 0x239e 0xa245 0x1801 0xec4 0x2599 0xa1cf 0x17c2 0xe7d 0x2793 0xa160 0x1795 0xe68 0x298e 0xa0ec 0x176b 0xe4b 0x2b88 0xa07f 0x174c 0xe2a 0x2d83 0xa017 0x1737 0xdfa 0x2f7e 0x9faa 0x1722 0xdd8 0x3178 0x9f45 0x170d 0xde4 0x3373 0x9ed8 0x16f8 0xdb6 0x356d 0x9e6a 0x16d2 0xdaa 0x3768 0x9df8 0x168f 0xda6 0x3962 0x9d83 0x1655 0xd97 0x3b5d 0x9d0f 0x1637 0xd94 0x3d58 0x9ca1 0x15f9 0xd8c 0x3f52 0x9c3c 0x15f9 0xd87 0x414d 0x9bd7 0x15d5 0xd75 0x4347 0x9b71 0x1582 0xd49 0x4542 0x9b10 0x1554 0xd4f 0x473c 0x9ab1 0x1551 0xd48 0x4937 0x9a4c 0x151a 0xd55 0x4b31 0x99ef 0x152f 0xd4f 0x4d2c 0x9983 0x14bc 0xd62 0x4f27 0x991b 0x147c 0xd7d 0x5121 0x98b6 0x1446 0xd94 0x531c 0x9854 0x1416 0xdcc 0x5516 0x97f9 0x13fd 0xdf8 0x5711 0x97a4 0x13d3 0xe10 0x590b 0x9750 0x13be 0xe12 0x5b06 0x9702 0x13a9 0xe47 0x5d01 0x96bc 0x13a1 0xe5b 0x5efb 0x967c 0x13aa 0xe66 0x60f6 0x9641 0x13ba 0xe5a 0x62f0 0x9606 0x13ba 0xe71 0x64eb 0x95ca 0x13ba 0xe69 0x66e5 0x9597 0x13cd 0xe6f 0x68e0 0x956a 0x13e2 0xe74 0x6adb 0x953c 0x13f7 0xe47 0x6cd5 0x950c 0x1405 0xe56 0x6ed0 0x94e3 0x140d 0xe36 0x70ca 0x94c2 0x144d 0xe2f 0x72c5 0x9498 0x1450 0xe2a 0x74bf 0x9474 0x1460 0xe1f 0x76ba 0x9457 0x148e 0xe30 0x78b5 0x943e 0x14bc 0xe27 0x7aaf 0x9425 0x14d6 0xe1c 0x7caa 0x940c 0x1501 0xe26 0x7ea4 0x93fb 0x1556 0xe07 0x809f 0x93ea 0x1598 0xe04 0x8299 0x93d9 0x15e6 0xdf6 0x8494 0x93c4 0x163a 0xdf3 0x868e 0x93ad 0x1695 0xded 0x8889 0x939c 0x16fe 0xde7 0x8a84 0x938b 0x1768 0xde1 0x8c7e 0x9373 0x17e5 0xdf3 0x8e79 0x9359 0x1854 0xde5 0x9073 0x9340 0x18d4 0xdef 0x926e 0x9324 0x1960 0xdf6 0x9468 0x9300 0x19e3 0xe01 0x9663 0x92d6 0x1a77 0xe00 0x985e 0x92b4 0x1b35 0xe13 0x9a58 0x9285 0x1bbf 0xe0a 0x9c53 0x9252 0x1c80 0xe03 0x9e4d 0x921c 0x1d5f 0xde0 0xa048 0x91e1 0x1e3d 0xdcf 0xa242 0x91a5 0x1f3b 0xdac 0xa43d 0x9163 0x2049 0xd79 0xa638 0x9118 0x216e 0xd1d 0xa832 0x90d7 0x22ec 0xc10 0xaa2d 0x9098 0x2492 0xb03 0xac27 0x905a 0x265a 0xb37 0xae22 0x9027 0x2875 0xa05 0xb01c 0x8ff5 0x2ad9 0x8f5 0xb217 0x8fc2 0x2d65 0x862 0xb411 0x8f89 0x3004 0x78c 0xb60c 0x8f3a 0x3282 0x750 0xb807 0x8eb8 0x34c5 0x725 0xba01 0x8ddf 0x36eb 0x67d 0xbbfc 0x8c86 0x3977 0x5ec 0xbdf6 0x8a37 0x3ea9 0x5cd 0xbff1 0x86d3 0x3fb8 0x622 0xc1eb 0x81a6 0x32e6 0x6f2 0xc3e6 0x81a6 0x32e1 0x8ac>;
		battery1_profile_t3_col = <0x04>;
		battery1_profile_t3_num = <0x64>;
		battery1_profile_t4 = <0x00 0xabf4 0x30a2 0x1fb 0xab21 0x30a2 0x3f5 0xaa63 0x30e7 0x5f0 0xa9ae 0x30d1 0x7ea 0xa901 0x3057 0x9e5 0xa85a 0x2fae 0xbdf 0xa7bb 0x2f08 0xdda 0xa72b 0x2e8a 0xfd5 0xa694 0x2dd2 0x11cf 0xa608 0x2d32 0x13ca 0xa581 0x2c9f 0x15c4 0xa4fa 0x2c04 0x17bf 0xa476 0x2b65 0x19b9 0xa3ff 0x2afb 0x1bb4 0xa381 0x2cce 0x1dae 0xa308 0x2b7c 0x1fa9 0xa291 0x297b 0x21a4 0xa21d 0x2907 0x239e 0xa1af 0x28ae 0x2599 0xa139 0x281a 0x2793 0xa0d2 0x27d2 0x298e 0xa066 0x2774 0x2b88 0x9ffd 0x2721 0x2d83 0x9f95 0x26da 0x2f7e 0x9f26 0x2689 0x3178 0x9eb0 0x264a 0x3373 0x9e31 0x25cd 0x356d 0x9db3 0x255f 0x3768 0x9d35 0x24de 0x3962 0x9cbb 0x246d 0x3b5d 0x9c47 0x2425 0x3d58 0x9bd9 0x23be 0x3f52 0x9b74 0x23be 0x414d 0x9b0f 0x230c 0x4347 0x9aaf 0x22e0 0x4542 0x9a56 0x2300 0x473c 0x99ff 0x22fd 0x4937 0x99a2 0x22bd 0x4b31 0x9945 0x227e 0x4d2c 0x98e9 0x228c 0x4f27 0x9892 0x2244 0x5121 0x983d 0x21e6 0x531c 0x97ec 0x21a2 0x5516 0x97a0 0x218b 0x5711 0x9754 0x21ca 0x590b 0x9708 0x21b5 0x5b06 0x96c3 0x21a0 0x5d01 0x9680 0x218b 0x5efb 0x9643 0x2192 0x60f6 0x960f 0x21b1 0x62f0 0x95d4 0x21b3 0x64eb 0x95a2 0x21c8 0x66e5 0x956f 0x21ca 0x68e0 0x9542 0x21e8 0x6adb 0x9518 0x2207 0x6cd5 0x94ee 0x221c 0x6ed0 0x94c5 0x2231 0x70ca 0x94a4 0x2246 0x72c5 0x948a 0x2283 0x74bf 0x9471 0x22c2 0x76ba 0x9457 0x2302 0x78b5 0x9441 0x2349 0x7aaf 0x942f 0x239e 0x7caa 0x9415 0x23f3 0x7ea4 0x93fc 0x245c 0x809f 0x93ea 0x24c6 0x8299 0x93d9 0x253d 0x8494 0x93c4 0x25c6 0x868e 0x93ad 0x264e 0x8889 0x939b 0x26c2 0x8a84 0x9382 0x2795 0x8c7e 0x9369 0x281b 0x8e79 0x934f 0x28c8 0x9073 0x9331 0x294c 0x926e 0x9310 0x29ce 0x9468 0x92ef 0x2a9e 0x9663 0x92d6 0x2b5c 0x985e 0x92ac 0x2c1a 0x9a58 0x9282 0x2cd8 0x9c53 0x9257 0x2da3 0x9e4d 0x9229 0x2e6c 0xa048 0x91f5 0x2f30 0xa242 0x91ba 0x3004 0xa43d 0x917f 0x30e9 0xa638 0x9144 0x31e3 0xa832 0x90fe 0x32c3 0xaa2d 0x90ba 0x33b6 0xac27 0x907f 0x34c8 0xae22 0x9046 0x35e6 0xb01c 0x901c 0x374d 0xb217 0x8ffa 0x38f0 0xb411 0x8fd2 0x3ae7 0xb60c 0x8f9e 0x3d71 0xb807 0x8f45 0x40d9 0xba01 0x8e93 0x4574 0xbbfc 0x8d3c 0x4b72 0xbdf6 0x8b12 0x4a6d 0xbff1 0x87d9 0x4246 0xc1eb 0x87d2 0x421d 0xc3e6 0x87d2 0x421d>;
		battery1_profile_t4_col = <0x03>;
		battery1_profile_t4_num = <0x64>;
		battery2_profile_t0 = <0x00 0xac58 0x33e 0x26a 0xab73 0x33a 0x4d4 0xaae9 0x34c 0x73e 0xaa6d 0x352 0x9a8 0xa9fc 0x35f 0xc11 0xa98a 0x375 0xe7b 0xa90f 0x37d 0x10e5 0xa895 0x36b 0x134f 0xa821 0x36d 0x15b9 0xa7a6 0x383 0x1823 0xa722 0x36f 0x1a8d 0xa6a5 0x36b 0x1cf7 0xa629 0x37a 0x1f60 0xa5a9 0x378 0x21ca 0xa528 0x36b 0x2434 0xa4ad 0x371 0x269e 0xa433 0x384 0x2908 0xa3b7 0x384 0x2b72 0xa33c 0x384 0x2ddc 0xa2c0 0x384 0x3046 0xa244 0x384 0x32af 0xa1ce 0x384 0x3519 0xa15b 0x38e 0x3783 0xa0e6 0x396 0x39ed 0xa06c 0x384 0x3c57 0x9ffa 0x385 0x3ec1 0x9f90 0x39b 0x412b 0x9f1e 0x39d 0x4395 0x9eb2 0x39d 0x45fe 0x9e48 0x3ac 0x4868 0x9dde 0x3b6 0x4ad2 0x9d78 0x3b6 0x4d3c 0x9d17 0x3b6 0x4fa6 0x9cb5 0x3b9 0x5210 0x9c54 0x3cf 0x547a 0x9bfc 0x3e5 0x56e4 0x9b9c 0x3e8 0x594e 0x9b41 0x3f8 0x5bb7 0x9ae9 0x401 0x5e21 0x9a91 0x416 0x608b 0x9a36 0x433 0x62f5 0x99cc 0x426 0x655f 0x993f 0x3e5 0x67c9 0x98b1 0x3b9 0x6a33 0x983d 0x3a1 0x6c9d 0x97e0 0x38c 0x6f06 0x978e 0x384 0x7170 0x9748 0x384 0x73da 0x970a 0x384 0x7644 0x96cc 0x384 0x78ae 0x9690 0x384 0x7b18 0x965b 0x384 0x7d82 0x961d 0x36e 0x7fec 0x95ee 0x37e 0x8255 0x95bc 0x384 0x84bf 0x958c 0x384 0x8729 0x9560 0x384 0x8993 0x9534 0x384 0x8bfd 0x9509 0x388 0x8e67 0x94e6 0x39e 0x90d1 0x94c3 0x3b4 0x933b 0x949f 0x3b6 0x95a4 0x947c 0x3b6 0x980e 0x9459 0x3b6 0x9a78 0x9435 0x3b6 0x9ce2 0x9416 0x3bf 0x9f4c 0x93f9 0x3cf 0xa1b6 0x93d7 0x3d2 0xa420 0x93bc 0x3e8 0xa68a 0x9376 0x3a6 0xa8f4 0x9328 0x38a 0xab5d 0x92e5 0x384 0xadc7 0x92b2 0x391 0xb031 0x9286 0x39d 0xb29b 0x9259 0x39d 0xb505 0x922d 0x39d 0xb76f 0x9202 0x39d 0xb9d9 0x91df 0x39d 0xbc43 0x91bc 0x3b1 0xbeac 0x9192 0x3b6 0xc116 0x9160 0x3b6 0xc380 0x9126 0x3ab 0xc5ea 0x90e8 0x39d 0xc854 0x90ab 0x3a2 0xcabe 0x906b 0x3b3 0xcd28 0x901b 0x39d 0xcf92 0x8fdd 0x387 0xd1fb 0x8fc5 0x384 0xd465 0x8fba 0x3a4 0xd6cf 0x8fac 0x3c3 0xd939 0x8f96 0x3ed 0xdba3 0x8f6d 0x428 0xde0d 0x8eff 0x437 0xe077 0x8dda 0x3d0 0xe2e1 0x8bf5 0x3e6 0xe54a 0x896d 0x425 0xe7b4 0x85dd 0x48a 0xea1e 0x7fab 0x6c6 0xec88 0x749a 0x1243 0xeef2 0x73a0 0xfb9>;
		battery2_profile_t0_col = <0x03>;
		battery2_profile_t0_num = <0x64>;
		battery2_profile_t1 = <0x00 0xac30 0x406 0x26a 0xabb4 0x402 0x4d4 0xab39 0x3ee 0x73e 0xaaca 0x3f8 0x9a8 0xaa5b 0x401 0xc11 0xa9e8 0x3f7 0xe7b 0xa976 0x3ef 0x10e5 0xa901 0x3fd 0x134f 0xa885 0x3e8 0x15b9 0xa80a 0x3e8 0x1823 0xa78e 0x3e8 0x1a8d 0xa713 0x3fa 0x1cf7 0xa697 0x401 0x1f60 0xa617 0x3f5 0x21ca 0xa596 0x3f1 0x2434 0xa51b 0x401 0x269e 0xa4a0 0x3fe 0x2908 0xa41b 0x3e8 0x2b72 0xa3a8 0x3fe 0x2ddc 0xa326 0x401 0x3046 0xa2af 0x411 0x32af 0xa237 0x41a 0x3519 0xa1bf 0x41a 0x3783 0xa14a 0x41a 0x39ed 0xa0d0 0x41a 0x3c57 0xa05d 0x41a 0x3ec1 0x9fea 0x41a 0x412b 0x9f80 0x42e 0x4395 0x9f0f 0x433 0x45fe 0x9ea2 0x442 0x4868 0x9e38 0x44c 0x4ad2 0x9dd2 0x455 0x4d3c 0x9d71 0x46b 0x4fa6 0x9d0f 0x481 0x5210 0x9cae 0x497 0x547a 0x9c4d 0x497 0x56e4 0x9bec 0x4aa 0x594e 0x9b91 0x4c0 0x5bb7 0x9b34 0x4d6 0x5e21 0x9ad3 0x4e2 0x608b 0x9a75 0x4e9 0x62f5 0x9a17 0x4f7 0x655f 0x99a3 0x4de 0x67c9 0x991f 0x49b 0x6a33 0x9892 0x445 0x6c9d 0x9822 0x410 0x6f06 0x97c5 0x401 0x7170 0x9775 0x401 0x73da 0x972f 0x3f8 0x7644 0x96ea 0x3e8 0x78ae 0x96ae 0x3e8 0x7b18 0x9679 0x3e8 0x7d82 0x9644 0x3e8 0x7fec 0x960f 0x3e8 0x8255 0x95e0 0x3f8 0x84bf 0x95b4 0x401 0x8729 0x9588 0x401 0x8993 0x955c 0x401 0x8bfd 0x9531 0x401 0x8e67 0x950e 0x403 0x90d1 0x94eb 0x430 0x933b 0x94c7 0x433 0x95a4 0x94a4 0x433 0x980e 0x9481 0x433 0x9a78 0x9462 0x433 0x9ce2 0x9448 0x43c 0x9f4c 0x942d 0x452 0xa1b6 0x9413 0x465 0xa420 0x93f8 0x465 0xa68a 0x93d5 0x44f 0xa8f4 0x93b9 0x44c 0xab5d 0x9392 0x43c 0xadc7 0x9366 0x426 0xb031 0x933a 0x41a 0xb29b 0x930d 0x413 0xb505 0x92e3 0x405 0xb76f 0x92c0 0x419 0xb9d9 0x9294 0x403 0xbc43 0x9278 0x415 0xbeac 0x9256 0x42b 0xc116 0x922d 0x425 0xc380 0x91fd 0x425 0xc5ea 0x91c1 0x422 0xc854 0x917d 0x401 0xcabe 0x9140 0x406 0xcd28 0x910b 0x432 0xcf92 0x90ab 0x408 0xd1fb 0x906f 0x3ee 0xd465 0x9053 0x3f8 0xd6cf 0x9042 0x40e 0xd939 0x9030 0x424 0xdba3 0x901e 0x448 0xde0d 0x9005 0x486 0xe077 0x8fbc 0x4ac 0xe2e1 0x8ebc 0x46a 0xe54a 0x8ce1 0x465 0xe7b4 0x8a61 0x4aa 0xea1e 0x86c7 0x520 0xec88 0x8036 0x976 0xeef2 0x74e0 0x130b>;
		battery2_profile_t1_col = <0x03>;
		battery2_profile_t1_num = <0x64>;
		battery2_profile_t2 = <0x00 0xac58 0x514 0x4d8 0x26a 0xabe5 0x514 0xca0 0x4d4 0xab73 0x561 0xca0 0x73e 0xab00 0x568 0xca0 0x9a8 0xaa92 0x55f 0xca0 0xc11 0xaa28 0x569 0xca0 0xe7b 0xa9bc 0x578 0xc61 0x10e5 0xa947 0x578 0xb8e 0x134f 0xa8cc 0x578 0xade 0x15b9 0xa859 0x578 0xa35 0x1823 0xa7d6 0x578 0x9c9 0x1a8d 0xa759 0x578 0x960 0x1cf7 0xa6dd 0x578 0x928 0x1f60 0xa65d 0x56c 0x906 0x21ca 0xa5dc 0x568 0x8e8 0x2434 0xa561 0x578 0x8d6 0x269e 0xa4e6 0x578 0x8ea 0x2908 0xa461 0x578 0x908 0x2b72 0xa3e6 0x578 0x7c2 0x2ddc 0xa36a 0x578 0x796 0x3046 0xa2ee 0x578 0x768 0x32af 0xa273 0x578 0x742 0x3519 0xa1fb 0x582 0x722 0x3783 0xa186 0x591 0x70d 0x39ed 0xa10c 0x595 0x6f3 0x3c57 0xa099 0x5aa 0x6de 0x3ec1 0xa026 0x5aa 0x6d0 0x412b 0x9fb4 0x5be 0x6bb 0x4395 0x9f48 0x5d5 0x6b7 0x45fe 0x9ede 0x5dc 0x6af 0x4868 0x9e74 0x5f3 0x6a8 0x4ad2 0x9e0a 0x60e 0x69c 0x4d3c 0x9da0 0x61a 0x69e 0x4fa6 0x9d36 0x640 0x69d 0x5210 0x9ccc 0x640 0x69d 0x547a 0x9c6b 0x656 0x69c 0x56e4 0x9c12 0x659 0x696 0x594e 0x9bb3 0x669 0x6a0 0x5bb7 0x9b57 0x68c 0x6be 0x5e21 0x9afb 0x6a4 0x6a0 0x608b 0x9a97 0x6a4 0x6a8 0x62f5 0x9a29 0x697 0x6a9 0x655f 0x99ad 0x653 0x6b5 0x67c9 0x991f 0x5fb 0x6c7 0x6a33 0x989a 0x5a3 0x6db 0x6c9d 0x982c 0x56e 0x6ff 0x6f06 0x97cf 0x55f 0x71a 0x7170 0x977f 0x55f 0x72e 0x73da 0x9739 0x556 0x736 0x7644 0x96f4 0x546 0x73c 0x78ae 0x96b7 0x546 0x735 0x7b18 0x9679 0x546 0x744 0x7d82 0x9644 0x546 0x740 0x7fec 0x960f 0x559 0x74a 0x8255 0x95da 0x54f 0x743 0x84bf 0x95aa 0x553 0x743 0x8729 0x957e 0x55f 0x740 0x8993 0x9552 0x55f 0x740 0x8bfd 0x9526 0x55f 0x73b 0x8e67 0x94fa 0x55f 0x73b 0x90d1 0x94d7 0x55f 0x738 0x933b 0x94b3 0x573 0x735 0x95a4 0x9490 0x578 0x736 0x980e 0x946d 0x578 0x734 0x9a78 0x944e 0x584 0x734 0x9ce2 0x9434 0x59a 0x733 0x9f4c 0x9419 0x5aa 0x766 0xa1b6 0x93ff 0x5aa 0x740 0xa420 0x93e4 0x5aa 0x787 0xa68a 0x93ca 0x5aa 0x75b 0xa8f4 0x93b7 0x5bd 0x7fc 0xab5d 0x939f 0x5b3 0x812 0xadc7 0x9384 0x5aa 0x80e 0xb031 0x936a 0x5aa 0x814 0xb29b 0x934c 0x5a3 0x815 0xb505 0x9326 0x588 0x818 0xb76f 0x92f2 0x560 0x81c 0xb9d9 0x92cf 0x576 0x81b 0xbc43 0x92ac 0x578 0x829 0xbeac 0x9288 0x578 0x828 0xc116 0x925f 0x586 0x828 0xc380 0x922f 0x591 0x81c 0xc5ea 0x91f3 0x591 0x809 0xc854 0x91af 0x596 0x7f3 0xcabe 0x9172 0x5ad 0x7e1 0xcd28 0x913d 0x5c3 0x7ca 0xcf92 0x90dd 0x5ad 0x7c6 0xd1fb 0x9092 0x5bd 0x7b7 0xd465 0x9065 0x5c3 0x7a6 0xd6cf 0x904c 0x5ea 0x79b 0xd939 0x9036 0x622 0x79b 0xdba3 0x9019 0x65c 0x78d 0xde0d 0x8ff1 0x6c1 0x76f 0xe077 0x8fab 0x75f 0x75a 0xe2e1 0x8ee0 0x83b 0x74d 0xe54a 0x8d01 0xa9a 0x74a 0xe7b4 0x8a10 0x19db 0x74f 0xea1e 0x7ed9 0x1adb 0x732 0xec88 0x74d6 0x12a7 0x6c3 0xeef2 0x74d6 0x12a7 0x69b>;
		battery2_profile_t2_col = <0x04>;
		battery2_profile_t2_num = <0x64>;
		battery2_profile_t3 = <0x00 0xac6c 0x7d0 0x4d8 0x26a 0xabf0 0x7d0 0xb32 0x4d4 0xab7d 0x7f6 0xb32 0x73e 0xab0a 0x7f2 0xb32 0x9a8 0xaa9c 0x7f6 0xb32 0xc11 0xaa2e 0x7ed 0xb32 0xe7b 0xa9be 0x7d7 0xb32 0x10e5 0xa951 0x7e5 0xb32 0x134f 0xa8d6 0x7d2 0xc14 0x15b9 0xa863 0x7e8 0xbbb 0x1823 0xa7e0 0x7c0 0xb1a 0x1a8d 0xa763 0x7c9 0xacc 0x1cf7 0xa6e7 0x7c1 0xa8e 0x1f60 0xa667 0x7b7 0xa58 0x21ca 0xa5e6 0x7b7 0xa24 0x2434 0xa56b 0x7bd 0xa1a 0x269e 0xa4f0 0x7cd 0x9e7 0x2908 0xa46b 0x7b7 0x9ef 0x2b72 0xa3f0 0x7b7 0x9e0 0x2ddc 0xa374 0x7ca 0x9d7 0x3046 0xa2f8 0x7d0 0x9b4 0x32af 0xa27d 0x7d0 0x9ad 0x3519 0xa201 0x7d0 0x9a4 0x3783 0xa189 0x7d7 0x99c 0x39ed 0xa116 0x7ed 0x9ae 0x3c57 0xa0a3 0x802 0x99d 0x3ec1 0xa027 0x802 0x9a2 0x412b 0x9fbc 0x816 0x9a3 0x4395 0x9f52 0x82d 0x9b9 0x45fe 0x9ee2 0x834 0x9b7 0x4868 0x9e74 0x84b 0x9b8 0x4ad2 0x9e07 0x86f 0x9c4 0x4d3c 0x9d96 0x87f 0x9dd 0x4fa6 0x9d2c 0x882 0x9f3 0x5210 0x9cc2 0x898 0xa0b 0x547a 0x9c58 0x882 0xa3d 0x56e4 0x9bf6 0x87f 0xa4f 0x594e 0x9b9b 0x88f 0xa85 0x5bb7 0x9b39 0x87e 0xa90 0x5e21 0x9acf 0x866 0xa9d 0x608b 0x9a62 0x85f 0xab5 0x62f5 0x99ec 0x83b 0xac9 0x655f 0x9968 0x7e5 0xaf6 0x67c9 0x98ec 0x7a2 0xb30 0x6a33 0x9879 0x775 0xb7b 0x6c9d 0x9815 0x75b 0xbc7 0x6f06 0x97bb 0x736 0xc11 0x7170 0x9767 0x716 0xc6b 0x73da 0x971b 0x708 0xc8a 0x7644 0x96d9 0x70e 0xcb2 0x78ae 0x96a3 0x721 0xccc 0x7b18 0x9665 0x721 0xcec 0x7d82 0x9627 0x721 0xce1 0x7fec 0x95f1 0x721 0xcef 0x8255 0x95c2 0x731 0xcff 0x84bf 0x9591 0x73a 0xd1a 0x8729 0x9560 0x73a 0xd23 0x8993 0x9534 0x741 0xd23 0x8bfd 0x9509 0x757 0xd41 0x8e67 0x94e6 0x76b 0xd50 0x90d1 0x94b9 0x755 0xd5a 0x933b 0x9495 0x767 0xd5e 0x95a4 0x9479 0x77d 0xd53 0x980e 0x9459 0x794 0xd75 0x9a78 0x943a 0x79e 0xd6a 0x9ce2 0x941c 0x79e 0xd8a 0x9f4c 0x93fd 0x7a4 0xd82 0xa1b6 0x93eb 0x7b7 0xdbc 0xa420 0x93d0 0x7b7 0xdac 0xa68a 0x93be 0x7cd 0xdaf 0xa8f4 0x93ad 0x7d0 0xdb1 0xab5d 0x939b 0x7d0 0xda8 0xadc7 0x938a 0x7dd 0xdcb 0xb031 0x9374 0x7e9 0xdba 0xb29b 0x9359 0x7f0 0xddf 0xb505 0x933b 0x7fe 0xdab 0xb76f 0x9310 0x7e9 0xdc5 0xb9d9 0x92e4 0x7e9 0xdac 0xbc43 0x92c0 0x811 0xdac 0xbeac 0x9296 0x82c 0xdb1 0xc116 0x9269 0x851 0xd98 0xc380 0x9230 0x871 0xd6e 0xc5ea 0x91e9 0x890 0xd59 0xc854 0x91a5 0x8bc 0xd1f 0xcabe 0x9166 0x8eb 0xcf5 0xcd28 0x911f 0x92d 0xca1 0xcf92 0x90bf 0x96f 0xc97 0xd1fb 0x906c 0x9c4 0xc68 0xd465 0x903d 0xa5c 0xc6a 0xd6cf 0x9014 0xb26 0xc1c 0xd939 0x8fe8 0xc52 0xbf3 0xdba3 0x8fb6 0xe65 0xc1a 0xde0d 0x8f6d 0x1246 0xc49 0xe077 0x8ee8 0x1a0e 0xc3f 0xe2e1 0x8db3 0x31ad 0xc48 0xe54a 0x8897 0x361a 0xc4c 0xe7b4 0x799c 0x1ec1 0xc45 0xea1e 0x77e2 0x1a45 0xb9b 0xec88 0x77e2 0x1a45 0x980 0xeef2 0x77e2 0x1a45 0x38c>;
		battery2_profile_t3_col = <0x04>;
		battery2_profile_t3_num = <0x64>;
		battery2_profile_t4 = <0x00 0xac62 0xdac 0x26a 0xabcc 0xdac 0x4d4 0xab4d 0xdac 0x73e 0xaad8 0xdac 0x9a8 0xaa65 0xd9f 0xc11 0xa9f2 0xd89 0xe7b 0xa980 0xd7a 0x10e5 0xa90b 0xd76 0x134f 0xa890 0xd61 0x15b9 0xa81d 0xd61 0x1823 0xa7a2 0xd61 0x1a8d 0xa727 0xd4f 0x1cf7 0xa6a5 0xd39 0x1f60 0xa626 0xd23 0x21ca 0xa5a6 0xd16 0x2434 0xa525 0xd10 0x269e 0xa4ab 0xcfd 0x2908 0xa42f 0xcfd 0x2b72 0xa3b4 0xd13 0x2ddc 0xa338 0xd16 0x3046 0xa2bc 0xd16 0x32af 0xa241 0xd16 0x3519 0xa1c9 0xd2a 0x3783 0xa154 0xd41 0x39ed 0xa0da 0xd38 0x3c57 0xa067 0xd61 0x3ec1 0x9ff4 0xd61 0x412b 0x9f82 0xd61 0x4395 0x9f16 0xd73 0x45fe 0x9ea6 0xd97 0x4868 0x9e2f 0xdac 0x4ad2 0x9db3 0xdac 0x4d3c 0x9d3a 0xdac 0x4fa6 0x9cc7 0xda9 0x5210 0x9c54 0xd93 0x547a 0x9be2 0xd7d 0x56e4 0x9b6f 0xd54 0x594e 0x9b03 0xd38 0x5bb7 0x9a99 0xd15 0x5e21 0x9a2b 0xce8 0x608b 0x99b8 0xcc4 0x62f5 0x9945 0xca9 0x655f 0x98d4 0xc7f 0x67c9 0x9872 0xc68 0x6a33 0x9811 0xc52 0x6c9d 0x97b8 0xc3d 0x6f06 0x9766 0xc35 0x7170 0x971b 0xc35 0x73da 0x96d5 0xc35 0x7644 0x9690 0xc3b 0x78ae 0x9654 0xc51 0x7b18 0x961f 0xc67 0x7d82 0x95ea 0xc7d 0x7fec 0x95b5 0xc80 0x8255 0x9580 0xc90 0x84bf 0x9550 0xca6 0x8729 0x9524 0xcbc 0x8993 0x94f8 0xccb 0x8bfd 0x94cd 0xcd3 0x8e67 0x94aa 0xcfe 0x90d1 0x9487 0xd14 0x933b 0x9463 0xd2a 0x95a4 0x9440 0xd2f 0x980e 0x9423 0xd3e 0x9a78 0x940d 0xd5f 0x9ce2 0x93f8 0xd83 0x9f4c 0x93e2 0xd9e 0xa1b6 0x93d8 0xdcb 0xa420 0x93c6 0xdf7 0xa68a 0x93b4 0xe23 0xa8f4 0x93a3 0xe4f 0xab5d 0x9391 0xe8b 0xadc7 0x9380 0xecd 0xb031 0x936a 0xf1a 0xb29b 0x934c 0xf6b 0xb505 0x9329 0xfad 0xb76f 0x9306 0xff0 0xb9d9 0x92da 0x105e 0xbc43 0x92ae 0x10cd 0xbeac 0x927b 0x114c 0xc116 0x9240 0x11df 0xc380 0x91fe 0x127a 0xc5ea 0x91b7 0x1325 0xc854 0x9170 0x13f6 0xcabe 0x9128 0x14f1 0xcd28 0x90cf 0x1626 0xcf92 0x906f 0x1786 0xd1fb 0x9024 0x197d 0xd465 0x8fea 0x1c3d 0xd6cf 0x8fb5 0x205d 0xd939 0x8f7c 0x279d 0xdba3 0x8f36 0x333d 0xde0d 0x8ea6 0x4218 0xe077 0x8cc0 0x4e70 0xe2e1 0x7cbe 0x2678 0xe54a 0x7bde 0x2454 0xe7b4 0x7bde 0x2454 0xea1e 0x7bde 0x2454 0xec88 0x7bde 0x2454 0xeef2 0x7bde 0x2454>;
		battery2_profile_t4_col = <0x03>;
		battery2_profile_t4_num = <0x64>;
		battery3_profile_t0 = <0x00 0xab36 0x3a2 0x1fb 0xaaa6 0x39e 0x3f5 0xaa25 0x39d 0x5f0 0xa9ab 0x3aa 0x7ea 0xa935 0x3b6 0x9e5 0xa8bf 0x3b6 0xbdf 0xa848 0x3b6 0xdda 0xa7ca 0x3b6 0xfd5 0xa752 0x3b6 0x11cf 0xa6d6 0x3a7 0x13ca 0xa65c 0x3a8 0x15c4 0xa5e3 0x3af 0x17bf 0xa566 0x3a0 0x19b9 0xa4ef 0x3b5 0x1bb4 0xa478 0x3fe 0x1dae 0xa402 0x3e5 0x1fa9 0xa38b 0x3b6 0x21a4 0xa313 0x3b1 0x239e 0xa296 0x39f 0x2599 0xa228 0x3b4 0x2793 0xa1b3 0x3b6 0x298e 0xa13c 0x3a7 0x2b88 0xa0cb 0x3a8 0x2d83 0xa05d 0x3b6 0x2f7e 0x9fef 0x3b6 0x3178 0x9f81 0x3b6 0x3373 0x9f14 0x3b6 0x356d 0x9ead 0x3c7 0x3768 0x9e48 0x3cf 0x3962 0x9de4 0x3cf 0x3b5d 0x9d7f 0x3cf 0x3d58 0x9d1a 0x3d0 0x3f52 0x9cc5 0x3e5 0x414d 0x9c63 0x3e8 0x4347 0x9c08 0x3f6 0x4542 0x9bb0 0x401 0x473c 0x9b58 0x40d 0x4937 0x9b0b 0x435 0x4b31 0x9ab7 0x44a 0x4d2c 0x9a5b 0x45f 0x4f27 0x99f7 0x465 0x5121 0x9980 0x442 0x531c 0x98f5 0x403 0x5516 0x986c 0x3c7 0x5711 0x97fe 0x39d 0x590b 0x97aa 0x39d 0x5b06 0x9763 0x39d 0x5d01 0x9720 0x39d 0x5efb 0x96e0 0x39d 0x60f6 0x96a5 0x398 0x62f0 0x966a 0x384 0x64eb 0x962e 0x384 0x66e5 0x95fb 0x384 0x68e0 0x95c8 0x384 0x6adb 0x9596 0x384 0x6cd5 0x9566 0x38b 0x6ed0 0x953c 0x39a 0x70ca 0x9512 0x385 0x72c5 0x94f0 0x398 0x74bf 0x94c8 0x39d 0x76ba 0x94a2 0x3a9 0x78b5 0x9481 0x3b6 0x7aaf 0x945f 0x3b6 0x7caa 0x943d 0x3b6 0x7ea4 0x941b 0x3b6 0x809f 0x9401 0x3c8 0x8299 0x93e2 0x3dd 0x8494 0x93c0 0x3e8 0x868e 0x9399 0x3e2 0x8889 0x9363 0x3cb 0x8a84 0x930f 0x3a0 0x8c7e 0x92ca 0x39d 0x8e79 0x9299 0x3ad 0x9073 0x926f 0x3b6 0x926e 0x9241 0x3b6 0x9468 0x9210 0x3b6 0x9663 0x91e6 0x3b6 0x985e 0x91bc 0x3a1 0x9a58 0x9199 0x3ae 0x9c53 0x9171 0x3b6 0x9e4d 0x9140 0x3b6 0xa048 0x9105 0x3b6 0xa242 0x90ca 0x3b6 0xa43d 0x908f 0x3b6 0xa638 0x904d 0x3b6 0xa832 0x8ffe 0x399 0xaa2d 0x8fc3 0x38f 0xac27 0x8fa9 0x3a4 0xae22 0x8fa1 0x3bc 0xb01c 0x8f98 0x3e6 0xb217 0x8f80 0x410 0xb411 0x8f60 0x45b 0xb60c 0x8ee1 0x44d 0xb807 0x8dbe 0x412 0xba01 0x8be3 0x413 0xbbfc 0x897b 0x468 0xbdf6 0x85e3 0x4e7 0xbff1 0x7f35 0x863 0xc1eb 0x74a4 0x1469 0xc3e6 0x74a4 0x1469>;
		battery3_profile_t0_col = <0x03>;
		battery3_profile_t0_num = <0x64>;
		battery3_profile_t1 = <0x00 0xab7c 0x65e 0x1fb 0xaaf5 0x65a 0x3f5 0xaa7c 0x659 0x5f0 0xaa05 0x659 0x7ea 0xa98f 0x659 0x9e5 0xa919 0x653 0xbdf 0xa8a3 0x640 0xdda 0xa82d 0x640 0xfd5 0xa7b6 0x640 0x11cf 0xa73a 0x622 0x13ca 0xa6c0 0x60e 0x15c4 0xa647 0x607 0x17bf 0xa5ca 0x5f5 0x19b9 0xa553 0x5f5 0x1bb4 0xa4dc 0x674 0x1dae 0xa460 0x63a 0x1fa9 0xa3e9 0x5dc 0x21a4 0xa379 0x5dc 0x239e 0xa303 0x5dc 0x2599 0xa28d 0x5dc 0x2793 0xa217 0x5dc 0x298e 0xa1a6 0x5dc 0x2b88 0xa134 0x5dc 0x2d83 0xa0c1 0x5dc 0x2f7e 0xa053 0x5dc 0x3178 0x9fe5 0x5dc 0x3373 0x9f78 0x5dc 0x356d 0x9f11 0x5ed 0x3768 0x9eac 0x5f5 0x3962 0x9e48 0x5fd 0x3b5d 0x9de3 0x612 0x3d58 0x9d7d 0x627 0x3f52 0x9d18 0x627 0x414d 0x9cb3 0x627 0x4347 0x9c53 0x635 0x4542 0x9bfa 0x64a 0x473c 0x9ba6 0x65f 0x4937 0x9b50 0x672 0x4b31 0x9af3 0x672 0x4d2c 0x9a97 0x685 0x4f27 0x9a2d 0x67b 0x5121 0x99b6 0x64f 0x531c 0x9934 0x600 0x5516 0x98b0 0x59e 0x5711 0x983a 0x55f 0x590b 0x97dd 0x535 0x5b06 0x978e 0x52d 0x5d01 0x9748 0x52d 0x5efb 0x9704 0x524 0x60f6 0x96c3 0x514 0x62f0 0x9688 0x514 0x64eb 0x9656 0x514 0x66e5 0x9623 0x527 0x68e0 0x95f0 0x51e 0x6adb 0x95be 0x514 0x6cd5 0x958e 0x51b 0x6ed0 0x9564 0x52d 0x70ca 0x953a 0x52d 0x72c5 0x9510 0x52d 0x74bf 0x94ec 0x53d 0x76ba 0x94ca 0x546 0x78b5 0x94a9 0x54e 0x7aaf 0x9487 0x55f 0x7caa 0x9465 0x55f 0x7ea4 0x9443 0x55f 0x809f 0x9429 0x571 0x8299 0x940a 0x578 0x8494 0x93ec 0x578 0x868e 0x93d0 0x578 0x8889 0x93ae 0x576 0x8a84 0x9383 0x561 0x8c7e 0x9361 0x55f 0x8e79 0x9339 0x54f 0x9073 0x930f 0x53a 0x926e 0x92e5 0x52d 0x9468 0x92ba 0x52d 0x9663 0x9290 0x52d 0x985e 0x9266 0x52d 0x9a58 0x9243 0x52d 0x9c53 0x9221 0x53a 0x9e4d 0x91f7 0x54f 0xa048 0x91c3 0x55f 0xa242 0x9188 0x561 0xa43d 0x914d 0x575 0xa638 0x9112 0x58a 0xa832 0x90cc 0x591 0xaa2d 0x9080 0x59c 0xac27 0x9044 0x5b1 0xae22 0x902c 0x5c9 0xb01c 0x901b 0x5f3 0xb217 0x900a 0x631 0xb411 0x8ff3 0x681 0xb60c 0x8fc1 0x6ee 0xb807 0x8f30 0x742 0xba01 0x8df5 0x765 0xbbfc 0x8bed 0x7be 0xbdf6 0x891f 0x8bb 0xbff1 0x84ca 0xa7c 0xc1eb 0x7cab 0x1cb3 0xc3e6 0x7814 0x1c07>;
		battery3_profile_t1_col = <0x03>;
		battery3_profile_t1_num = <0x64>;
		battery3_profile_t2 = <0x00 0xabcc 0xec4 0x728 0x1fb 0xab2c 0xec0 0x728 0x3f5 0xaaa0 0xebf 0x71e 0x5f0 0xaa1e 0xeb2 0x738 0x7ea 0xa99f 0xe8a 0x710 0x9e5 0xa923 0xe50 0x704 0xbdf 0xa8ac 0xe24 0x743 0xdda 0xa82e 0xde5 0x743 0xfd5 0xa7b6 0xdcb 0x69c 0x11cf 0xa73a 0xd98 0x6fd 0x13ca 0xa6c0 0xd64 0x6eb 0x15c4 0xa647 0xd3a 0x66d 0x17bf 0xa5ca 0xd0f 0x68a 0x19b9 0xa553 0xce5 0x68a 0x1bb4 0xa4dc 0xdf3 0x69d 0x1dae 0xa466 0xd6c 0x636 0x1fa9 0xa3ef 0xc86 0x614 0x21a4 0xa37b 0xc62 0x680 0x239e 0xa30d 0xc4c 0x676 0x2599 0xa297 0xc37 0x684 0x2793 0xa221 0xc0f 0x6e5 0x298e 0xa1b0 0xc03 0x663 0x2b88 0xa13e 0xbed 0x65a 0x2d83 0xa0cb 0xbca 0x656 0x2f7e 0xa05e 0xbbb 0x63b 0x3178 0x9ff9 0xbd0 0x631 0x3373 0x9f8c 0xbbd 0x629 0x356d 0x9f25 0xbc9 0x62f 0x3768 0x9ec0 0xbdd 0x625 0x3962 0x9e59 0xbea 0x62e 0x3b5d 0x9deb 0xbe6 0x610 0x3d58 0x9d7d 0xbd1 0x62f 0x3f52 0x9d18 0xbd1 0x61d 0x414d 0x9cac 0xbad 0x636 0x4347 0x9c49 0xb9f 0x653 0x4542 0x9be8 0xb95 0x643 0x473c 0x9b85 0xb80 0x645 0x4937 0x9b28 0xb6b 0x635 0x4b31 0x9acb 0xb56 0x64b 0x4d2c 0x9a67 0xb41 0x634 0x4f27 0x99fb 0xb1c 0x65f 0x5121 0x9989 0xada 0x676 0x531c 0x9916 0xa8e 0x68e 0x5516 0x98a8 0xa4e 0x69e 0x5711 0x983a 0xa0f 0x6be 0x590b 0x97e6 0x9fa 0x6d7 0x5b06 0x9791 0x9e5 0x6cf 0x5d01 0x9742 0x9d0 0x6f6 0x5efb 0x96fa 0x9bb 0x710 0x60f6 0x96b9 0x9ab 0x6ec 0x62f0 0x967e 0x9ab 0x6fc 0x64eb 0x9642 0x9ab 0x71b 0x66e5 0x960f 0x9be 0x723 0x68e0 0x95dc 0x9d3 0x71e 0x6adb 0x95aa 0x9dd 0x71e 0x6cd5 0x957a 0x9e4 0x723 0x6ed0 0x9550 0x9f6 0x71e 0x70ca 0x9526 0x9f6 0x72c 0x72c5 0x94fc 0xa0a 0x72f 0x74bf 0x94d2 0xa0f 0x72d 0x76ba 0x94ac 0xa1b 0x739 0x78b5 0x948b 0xa30 0x726 0x7aaf 0x9469 0xa41 0x73a 0x7caa 0x9447 0xa42 0x73e 0x7ea4 0x9425 0xa57 0x73b 0x809f 0x940b 0xa6c 0x725 0x8299 0x93f1 0xa81 0x73e 0x8494 0x93d8 0xa8c 0x744 0x868e 0x93bf 0xa92 0x748 0x8889 0x93a6 0xaa7 0x745 0x8a84 0x9395 0xabc 0x73b 0x8c7e 0x937d 0xad1 0x733 0x8e79 0x9363 0xae7 0x749 0x9073 0x934a 0xb13 0x756 0x926e 0x932e 0xb43 0x73e 0x9468 0x930c 0xb5c 0x744 0x9663 0x92ea 0xb86 0x72f 0x985e 0x92c0 0xb86 0x73c 0x9a58 0x929d 0xbba 0x732 0x9c53 0x9275 0xc21 0x70c 0x9e4d 0x9247 0xc83 0x718 0xa048 0x9213 0xcc8 0x707 0xa242 0x91d8 0xd1e 0x6e4 0xa43d 0x919d 0xd86 0x6e8 0xa638 0x915b 0xe01 0x6dc 0xa832 0x9112 0xe80 0x6d3 0xaa2d 0x90c6 0xeff 0x6bc 0xac27 0x907f 0xf91 0x698 0xae22 0x9046 0x1055 0x6a6 0xb01c 0x901c 0x113d 0x69a 0xb217 0x8ffa 0x128a 0x69d 0xb411 0x8fd2 0x141c 0x682 0xb60c 0x8f94 0x160c 0x64f 0xb807 0x8f23 0x1849 0x604 0xba01 0x8e5a 0x1ac4 0x5d4 0xbbfc 0x8d13 0x1d9b 0x637 0xbdf6 0x8aee 0x21d0 0x670 0xbff1 0x87c9 0x28cc 0x6bb 0xc1eb 0x832a 0x3219 0x6d1 0xc3e6 0x79c2 0x1fbd 0x65a>;
		battery3_profile_t2_col = <0x04>;
		battery3_profile_t2_num = <0x64>;
		battery3_profile_t3 = <0x00 0xabcc 0x1b76 0x728 0x1fb 0xab0a 0x1b72 0x16d6 0x3f5 0xaa6a 0x1b71 0x16d6 0x5f0 0xa9d2 0x1b56 0x16e9 0x7ea 0xa942 0x1b2c 0x16fd 0x9e5 0xa8b8 0x1afc 0x1723 0xbdf 0xa82a 0x1abf 0x1723 0xdda 0xa7ac 0x1a95 0x174a 0xfd5 0xa725 0x1a57 0x1770 0x11cf 0xa6a4 0x1a18 0x15cf 0x13ca 0xa621 0x19ce 0x145f 0x15c4 0xa59d 0x1980 0x132b 0x17bf 0xa51e 0x1941 0x1226 0x19b9 0xa4a0 0x1902 0x1154 0x1bb4 0xa421 0x1ab2 0x1074 0x1dae 0xa3a8 0x19ca 0xfaa 0x1fa9 0xa331 0x1857 0xf4e 0x21a4 0xa2bb 0x182d 0xeea 0x239e 0xa245 0x1801 0xec4 0x2599 0xa1cf 0x17c2 0xe7d 0x2793 0xa160 0x1795 0xe68 0x298e 0xa0ec 0x176b 0xe4b 0x2b88 0xa07f 0x174c 0xe2a 0x2d83 0xa017 0x1737 0xdfa 0x2f7e 0x9faa 0x1722 0xdd8 0x3178 0x9f45 0x170d 0xde4 0x3373 0x9ed8 0x16f8 0xdb6 0x356d 0x9e6a 0x16d2 0xdaa 0x3768 0x9df8 0x168f 0xda6 0x3962 0x9d83 0x1655 0xd97 0x3b5d 0x9d0f 0x1637 0xd94 0x3d58 0x9ca1 0x15f9 0xd8c 0x3f52 0x9c3c 0x15f9 0xd87 0x414d 0x9bd7 0x15d5 0xd75 0x4347 0x9b71 0x1582 0xd49 0x4542 0x9b10 0x1554 0xd4f 0x473c 0x9ab1 0x1551 0xd48 0x4937 0x9a4c 0x151a 0xd55 0x4b31 0x99ef 0x152f 0xd4f 0x4d2c 0x9983 0x14bc 0xd62 0x4f27 0x991b 0x147c 0xd7d 0x5121 0x98b6 0x1446 0xd94 0x531c 0x9854 0x1416 0xdcc 0x5516 0x97f9 0x13fd 0xdf8 0x5711 0x97a4 0x13d3 0xe10 0x590b 0x9750 0x13be 0xe12 0x5b06 0x9702 0x13a9 0xe47 0x5d01 0x96bc 0x13a1 0xe5b 0x5efb 0x967c 0x13aa 0xe66 0x60f6 0x9641 0x13ba 0xe5a 0x62f0 0x9606 0x13ba 0xe71 0x64eb 0x95ca 0x13ba 0xe69 0x66e5 0x9597 0x13cd 0xe6f 0x68e0 0x956a 0x13e2 0xe74 0x6adb 0x953c 0x13f7 0xe47 0x6cd5 0x950c 0x1405 0xe56 0x6ed0 0x94e3 0x140d 0xe36 0x70ca 0x94c2 0x144d 0xe2f 0x72c5 0x9498 0x1450 0xe2a 0x74bf 0x9474 0x1460 0xe1f 0x76ba 0x9457 0x148e 0xe30 0x78b5 0x943e 0x14bc 0xe27 0x7aaf 0x9425 0x14d6 0xe1c 0x7caa 0x940c 0x1501 0xe26 0x7ea4 0x93fb 0x1556 0xe07 0x809f 0x93ea 0x1598 0xe04 0x8299 0x93d9 0x15e6 0xdf6 0x8494 0x93c4 0x163a 0xdf3 0x868e 0x93ad 0x1695 0xded 0x8889 0x939c 0x16fe 0xde7 0x8a84 0x938b 0x1768 0xde1 0x8c7e 0x9373 0x17e5 0xdf3 0x8e79 0x9359 0x1854 0xde5 0x9073 0x9340 0x18d4 0xdef 0x926e 0x9324 0x1960 0xdf6 0x9468 0x9300 0x19e3 0xe01 0x9663 0x92d6 0x1a77 0xe00 0x985e 0x92b4 0x1b35 0xe13 0x9a58 0x9285 0x1bbf 0xe0a 0x9c53 0x9252 0x1c80 0xe03 0x9e4d 0x921c 0x1d5f 0xde0 0xa048 0x91e1 0x1e3d 0xdcf 0xa242 0x91a5 0x1f3b 0xdac 0xa43d 0x9163 0x2049 0xd79 0xa638 0x9118 0x216e 0xd1d 0xa832 0x90d7 0x22ec 0xc10 0xaa2d 0x9098 0x2492 0xb03 0xac27 0x905a 0x265a 0xb37 0xae22 0x9027 0x2875 0xa05 0xb01c 0x8ff5 0x2ad9 0x8f5 0xb217 0x8fc2 0x2d65 0x862 0xb411 0x8f89 0x3004 0x78c 0xb60c 0x8f3a 0x3282 0x750 0xb807 0x8eb8 0x34c5 0x725 0xba01 0x8ddf 0x36eb 0x67d 0xbbfc 0x8c86 0x3977 0x5ec 0xbdf6 0x8a37 0x3ea9 0x5cd 0xbff1 0x86d3 0x3fb8 0x622 0xc1eb 0x81a6 0x32e6 0x6f2 0xc3e6 0x81a6 0x32e1 0x8ac>;
		battery3_profile_t3_col = <0x04>;
		battery3_profile_t3_num = <0x64>;
		battery3_profile_t4 = <0x00 0xabf4 0x30a2 0x1fb 0xab21 0x30a2 0x3f5 0xaa63 0x30e7 0x5f0 0xa9ae 0x30d1 0x7ea 0xa901 0x3057 0x9e5 0xa85a 0x2fae 0xbdf 0xa7bb 0x2f08 0xdda 0xa72b 0x2e8a 0xfd5 0xa694 0x2dd2 0x11cf 0xa608 0x2d32 0x13ca 0xa581 0x2c9f 0x15c4 0xa4fa 0x2c04 0x17bf 0xa476 0x2b65 0x19b9 0xa3ff 0x2afb 0x1bb4 0xa381 0x2cce 0x1dae 0xa308 0x2b7c 0x1fa9 0xa291 0x297b 0x21a4 0xa21d 0x2907 0x239e 0xa1af 0x28ae 0x2599 0xa139 0x281a 0x2793 0xa0d2 0x27d2 0x298e 0xa066 0x2774 0x2b88 0x9ffd 0x2721 0x2d83 0x9f95 0x26da 0x2f7e 0x9f26 0x2689 0x3178 0x9eb0 0x264a 0x3373 0x9e31 0x25cd 0x356d 0x9db3 0x255f 0x3768 0x9d35 0x24de 0x3962 0x9cbb 0x246d 0x3b5d 0x9c47 0x2425 0x3d58 0x9bd9 0x23be 0x3f52 0x9b74 0x23be 0x414d 0x9b0f 0x230c 0x4347 0x9aaf 0x22e0 0x4542 0x9a56 0x2300 0x473c 0x99ff 0x22fd 0x4937 0x99a2 0x22bd 0x4b31 0x9945 0x227e 0x4d2c 0x98e9 0x228c 0x4f27 0x9892 0x2244 0x5121 0x983d 0x21e6 0x531c 0x97ec 0x21a2 0x5516 0x97a0 0x218b 0x5711 0x9754 0x21ca 0x590b 0x9708 0x21b5 0x5b06 0x96c3 0x21a0 0x5d01 0x9680 0x218b 0x5efb 0x9643 0x2192 0x60f6 0x960f 0x21b1 0x62f0 0x95d4 0x21b3 0x64eb 0x95a2 0x21c8 0x66e5 0x956f 0x21ca 0x68e0 0x9542 0x21e8 0x6adb 0x9518 0x2207 0x6cd5 0x94ee 0x221c 0x6ed0 0x94c5 0x2231 0x70ca 0x94a4 0x2246 0x72c5 0x948a 0x2283 0x74bf 0x9471 0x22c2 0x76ba 0x9457 0x2302 0x78b5 0x9441 0x2349 0x7aaf 0x942f 0x239e 0x7caa 0x9415 0x23f3 0x7ea4 0x93fc 0x245c 0x809f 0x93ea 0x24c6 0x8299 0x93d9 0x253d 0x8494 0x93c4 0x25c6 0x868e 0x93ad 0x264e 0x8889 0x939b 0x26c2 0x8a84 0x9382 0x2795 0x8c7e 0x9369 0x281b 0x8e79 0x934f 0x28c8 0x9073 0x9331 0x294c 0x926e 0x9310 0x29ce 0x9468 0x92ef 0x2a9e 0x9663 0x92d6 0x2b5c 0x985e 0x92ac 0x2c1a 0x9a58 0x9282 0x2cd8 0x9c53 0x9257 0x2da3 0x9e4d 0x9229 0x2e6c 0xa048 0x91f5 0x2f30 0xa242 0x91ba 0x3004 0xa43d 0x917f 0x30e9 0xa638 0x9144 0x31e3 0xa832 0x90fe 0x32c3 0xaa2d 0x90ba 0x33b6 0xac27 0x907f 0x34c8 0xae22 0x9046 0x35e6 0xb01c 0x901c 0x374d 0xb217 0x8ffa 0x38f0 0xb411 0x8fd2 0x3ae7 0xb60c 0x8f9e 0x3d71 0xb807 0x8f45 0x40d9 0xba01 0x8e93 0x4574 0xbbfc 0x8d3c 0x4b72 0xbdf6 0x8b12 0x4a6d 0xbff1 0x87d9 0x4246 0xc1eb 0x87d2 0x421d 0xc3e6 0x87d2 0x421d>;
		battery3_profile_t4_col = <0x03>;
		battery3_profile_t4_num = <0x64>;
		enable_tmp_intr_suspend = <0x00>;
		g_FG_PSEUDO100_T0 = <0x61>;
		g_FG_PSEUDO100_T1 = <0x61>;
		g_FG_PSEUDO100_T2 = <0x61>;
		g_FG_PSEUDO100_T3 = <0x61>;
		g_FG_PSEUDO100_T4 = <0x61>;
};
